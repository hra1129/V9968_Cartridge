module hdmi_converter (
	input				reset_n,
	input				clk42m,			// 42.95454MHz = clk14m x 3
	input				clk28m,			// 28.63636MHz = clk14m x 2
	input				video_de,
	input				video_vs,		// Active low, as generated by vdp_video_out.
	input		[7:0]	video_r,
	input		[7:0]	video_g,
	input		[7:0]	video_b,
	output reg			display_hs,
	output reg			display_vs,
	output reg			display_en,
	output		[7:0]	display_r,
	output		[7:0]	display_g,
	output		[7:0]	display_b,
	output				locked,
	output reg			overflow,
	output reg			underflow,
	output reg			input_error
);
	localparam [10:0] H_IN_TOTAL	= 11'd1368;		// clk42m clocks per V9968 line
	localparam [9:0] H_TOTAL		= 10'd912;		// H_IN_TOTAL * 2 / 3: identical line period
	localparam [9:0] H_SYNC			= 10'd62;
	localparam [9:0] H_START		= 10'd122;
	localparam [9:0] H_END			= 10'd842;
	localparam [9:0] V_SYNC			= 10'd6;
	localparam [9:0] V_START		= 10'd36;
	localparam [9:0] V_END			= 10'd516;
	localparam [9:0] V_FREERUN		= 10'd524;
	localparam [10:0] ACQ_TIMEOUT	= 11'd2000;		// lines: > 3 input frames at 50Hz
	// Output h_count loaded when the first input line start is seen. Reading then begins
	// (H_TOTAL - H_LOCK) + H_START = 456 clocks (0.5 line) after the write began.
	localparam [9:0] H_LOCK			= 10'd578;

	localparam [2:0] ST_REQ		= 3'd0;		// resync: clear both FIFO sides
	localparam [2:0] ST_REL		= 3'd1;
	localparam [2:0] ST_ACQ		= 3'd2;		// wait for the first line of an input frame
	localparam [2:0] ST_FREE	= 3'd3;		// no input: blank frames for the monitor
	localparam [2:0] ST_LOCK	= 3'd4;

	reg [1:0] reset42;
	reg [1:0] reset28;
	always @( posedge clk42m or negedge reset_n ) begin
		if( !reset_n ) reset42 <= 2'b00;
		else reset42 <= { reset42[0], 1'b1 };
	end
	always @( posedge clk28m or negedge reset_n ) begin
		if( !reset_n ) reset28 <= 2'b00;
		else reset28 <= { reset28[0], 1'b1 };
	end

	function [3:0] gray_to_bin;
		input [3:0] gray;
		begin
			gray_to_bin[3] = gray[3];
			gray_to_bin[2] = gray[3] ^ gray[2];
			gray_to_bin[1] = gray[3] ^ gray[2] ^ gray[1];
			gray_to_bin[0] = ^gray;
		end
	endfunction

	// Two line slots. A line is read while it is still being written: the writer
	// (1 pixel/clk42m) is faster than the reader (1 pixel/clk28m), so a reader that
	// starts after the writer never overtakes it. Pointers count lines started (write)
	// and lines finished (read).
	reg [23:0] line_ram [0:2047];
	reg [23:0] ram_q;
	reg [3:0] write_bin;
	reg [3:0] write_gray;
	reg [3:0] read_bin;
	reg [3:0] read_gray;
	reg [3:0] read_gray_meta;
	reg [3:0] read_gray_sync;
	reg [3:0] write_gray_meta;
	reg [3:0] write_gray_sync;
	reg resync_req;
	reg resync_meta42;
	reg resync42;
	// Single clk42m capture of video_vs (clk85m domain), shared by the VS edge detectors.
	reg vs42;

	always @( posedge clk42m ) begin
		if( !reset42[1] )
			vs42 <= 1'b1;
		else
			vs42 <= video_vs;
	end

	// --------------------------------------------------------------------
	//	clk42m: input frame length measurement (hard reset only)
	// --------------------------------------------------------------------
	reg [10:0] meas_h;
	reg [9:0] meas_lines;
	reg meas_old_vs;
	reg meas_started;
	reg [9:0] frame_lines42;
	reg frame_t42;
	wire meas_wrap = meas_h == H_IN_TOTAL - 11'd1;
	wire meas_edge = meas_old_vs && !vs42;
	// The input period is an exact multiple of H_IN_TOTAL, so the wrap count between
	// VS edges is the line count regardless of the free-running counter's phase.
	wire [9:0] meas_now = (meas_wrap && meas_lines != 10'h3FF) ? meas_lines + 10'd1 : meas_lines;
	wire meas_valid = meas_started && meas_now > V_END && meas_now != 10'h3FF;

	always @( posedge clk42m ) begin
		if( !reset42[1] ) begin
			meas_h <= 11'd0;
			meas_lines <= 10'd0;
			meas_old_vs <= 1'b1;
			meas_started <= 1'b0;
			frame_lines42 <= 10'd0;
			frame_t42 <= 1'b0;
		end
		else begin
			meas_old_vs <= vs42;
			meas_h <= meas_wrap ? 11'd0 : meas_h + 11'd1;
			if( meas_edge ) begin
				meas_lines <= 10'd0;
				meas_started <= 1'b1;
				if( meas_started ) begin
					frame_lines42 <= meas_now;
					frame_t42 <= ~frame_t42;
				end
			end
			else
				meas_lines <= meas_now;
		end
	end

	// --------------------------------------------------------------------
	//	clk42m: line writer
	// --------------------------------------------------------------------
	wire clear42 = !reset42[1] || resync42;
	wire [3:0] write_next = write_bin + 4'd1;
	wire [3:0] write_used = write_bin - gray_to_bin(read_gray_sync);
	reg old_de;
	reg old_vs;
	reg armed;
	reg write_open;
	reg write_slot;
	reg [9:0] write_x;
	reg [9:0] write_y;
	reg overflow42;
	reg input_error42;
	wire write_ok = armed && !overflow42 && !input_error42;
	wire line_start = video_de && !old_de;
	// Both slots busy means the reader has not finished the line written two lines ago.
	wire start_ok = write_ok && write_y < 10'd480 && write_used < 4'd2;
	wire write_enable = !clear42 && video_de && write_x < 10'd720 &&
						(line_start ? start_ok : (write_open && write_ok));
	wire write_sel = line_start ? write_bin[0] : write_slot;

	always @( posedge clk42m ) begin
		if( write_enable )
			line_ram[{ write_sel, write_x }] <= { video_r, video_g, video_b };
	end

	always @( posedge clk42m ) begin
		if( !reset42[1] ) begin
			resync_meta42 <= 1'b0;
			resync42 <= 1'b0;
		end
		else begin
			resync_meta42 <= resync_req;
			resync42 <= resync_meta42;
		end
	end

	always @( posedge clk42m ) begin
		if( clear42 ) begin
			read_gray_meta <= 4'd0;
			read_gray_sync <= 4'd0;
			write_bin <= 4'd0;
			write_gray <= 4'd0;
			old_de <= 1'b0;
			old_vs <= 1'b1;
			armed <= 1'b0;
			write_open <= 1'b0;
			write_slot <= 1'b0;
			write_x <= 10'd0;
			write_y <= 10'd0;
			overflow42 <= 1'b0;
			input_error42 <= 1'b0;
		end
		else begin
			read_gray_meta <= read_gray;
			read_gray_sync <= read_gray_meta;
			old_de <= video_de;
			old_vs <= vs42;
			if( old_vs && !vs42 ) begin
				// Start only at a frame whose predecessor had a usable length.
				if( meas_valid )
					armed <= 1'b1;
				write_y <= 10'd0;
				if( armed && (write_y != 10'd480 || video_de || old_de) )
					input_error42 <= 1'b1;
			end
			if( write_ok ) begin
				if( line_start ) begin
					if( write_y >= 10'd480 )
						input_error42 <= 1'b1;
					else if( write_used >= 4'd2 )
						overflow42 <= 1'b1;
					else begin
						// Publish the line at its start: the reader may follow it.
						write_open <= 1'b1;
						write_slot <= write_bin[0];
						write_bin <= write_next;
						write_gray <= (write_next >> 1) ^ write_next;
						write_y <= write_y + 10'd1;
					end
				end
				if( video_de ) begin
					if( write_x >= 10'd720 )
						input_error42 <= 1'b1;
					else
						write_x <= write_x + 10'd1;
				end
				else begin
					write_x <= 10'd0;
					write_open <= 1'b0;
					if( old_de && write_open && write_x != 10'd720 )
						input_error42 <= 1'b1;
				end
			end
			else
				write_open <= 1'b0;
		end
	end

	// --------------------------------------------------------------------
	//	clk28m: output timing and line reader
	// --------------------------------------------------------------------
	reg [2:0] state;
	reg [9:0] h_count;
	reg [9:0] v_count;
	reg [10:0] hold_lines;
	reg line_valid;
	reg [9:0] frame_total;
	reg frame_valid;
	reg [9:0] locked_total;
	reg frame_t_meta;
	reg frame_t_sync;
	reg frame_t_seen;
	reg resync_ack_meta;
	reg resync_ack;
	reg [1:0] overflow_s;
	reg [1:0] input_error_s;

	wire [3:0] read_next = read_bin + 4'd1;
	wire [3:0] ready_lines = gray_to_bin(write_gray_sync) - read_bin;
	wire empty = read_gray == write_gray_sync;
	wire running = state == ST_ACQ || state == ST_FREE || state == ST_LOCK;
	wire line_end = h_count == H_TOTAL - 10'd1;
	wire active_line = v_count >= V_START && v_count < V_END;
	wire active_pixel = active_line && h_count >= H_START && h_count < H_END;
	wire read_enable = state == ST_LOCK && active_pixel && line_valid;
	wire [9:0] read_x = h_count - H_START;

	wire fault42 = overflow_s[1] || input_error_s[1];
	wire err_under = state == ST_LOCK && h_count == H_START - 10'd1 && active_line && empty;
	// The first line of an input frame has started (writer arms at VS only).
	wire acq_seen = state == ST_ACQ && !empty;
	wire acq_bad = acq_seen && (!frame_valid || ready_lines != 4'd1);
	// Locked frames must have the measured input length, and the first line must have
	// started (only that one) half a line before it is read; otherwise reacquire.
	wire frame_bad = state == ST_LOCK && (!frame_valid || frame_total != locked_total);
	wire start_bad = state == ST_LOCK && line_end && v_count == V_START - 10'd1 &&
					 ready_lines != 4'd1;
	wire input_seen = state == ST_FREE && ready_lines != 4'd0;
	wire go_resync = running && (fault42 || err_under || acq_bad || frame_bad || start_bad || input_seen);

	// Synchronous dual-clock RAM: data and timing outputs have the same one-clock latency.
	always @( posedge clk28m ) begin
		if( read_enable )
			ram_q <= line_ram[{ read_bin[0], read_x }];
	end

	always @( posedge clk28m ) begin
		if( !reset28[1] ) begin
			write_gray_meta <= 4'd0;
			write_gray_sync <= 4'd0;
			overflow_s <= 2'b00;
			input_error_s <= 2'b00;
			resync_ack_meta <= 1'b0;
			resync_ack <= 1'b0;
			frame_t_meta <= 1'b0;
			frame_t_sync <= 1'b0;
			frame_t_seen <= 1'b0;
			frame_total <= 10'd0;
			frame_valid <= 1'b0;
			locked_total <= 10'd0;
			resync_req <= 1'b0;
			state <= ST_ACQ;
			read_bin <= 4'd0;
			read_gray <= 4'd0;
			h_count <= 10'd0;
			v_count <= V_START - 10'd1;
			hold_lines <= 11'd0;
			line_valid <= 1'b0;
			overflow <= 1'b0;
			underflow <= 1'b0;
			input_error <= 1'b0;
			display_hs <= 1'b0;
			display_vs <= 1'b0;
			display_en <= 1'b0;
		end
		else begin
			write_gray_meta <= write_gray;
			write_gray_sync <= write_gray_meta;
			overflow_s <= { overflow_s[0], overflow42 };
			input_error_s <= { input_error_s[0], input_error42 };
			resync_ack_meta <= resync42;
			resync_ack <= resync_ack_meta;
			frame_t_meta <= frame_t42;
			frame_t_sync <= frame_t_meta;
			frame_t_seen <= frame_t_sync;
			if( frame_t_sync != frame_t_seen ) begin
				// frame_lines42 has been stable since frame_t42 toggled.
				frame_total <= frame_lines42;
				frame_valid <= frame_lines42 > V_END && frame_lines42 != 10'h3FF;
			end

			display_hs <= h_count < H_SYNC;
			display_vs <= v_count < V_SYNC;
			display_en <= read_enable;
			h_count <= line_end ? 10'd0 : h_count + 10'd1;

			// Sticky diagnostics; the converter itself recovers by resynchronizing.
			if( running ) begin
				if( overflow_s[1] ) overflow <= 1'b1;
				if( input_error_s[1] ) input_error <= 1'b1;
			end
			if( err_under ) underflow <= 1'b1;

			if( h_count == H_START - 10'd1 )
				line_valid <= state == ST_LOCK && active_line && !empty;
			if( read_enable && h_count == H_END - 10'd1 ) begin
				read_bin <= read_next;
				read_gray <= (read_next >> 1) ^ read_next;
			end

			if( go_resync ) begin
				state <= ST_REQ;
				resync_req <= 1'b1;
				read_bin <= 4'd0;
				read_gray <= 4'd0;
				line_valid <= 1'b0;
			end
			else if( state == ST_REQ ) begin
				if( resync_ack ) begin
					resync_req <= 1'b0;
					state <= ST_REL;
				end
			end
			else if( state == ST_REL ) begin
				if( !resync_ack ) begin
					hold_lines <= 11'd0;
					state <= ST_ACQ;
				end
			end

			if( line_end ) begin
				if( go_resync || state == ST_REQ || state == ST_REL ) begin
					// Wait just before the active area, ahead of the input's next frame.
					v_count <= V_START - 10'd1;
				end
				else if( state == ST_ACQ ) begin
					if( v_count != V_START - 10'd1 )
						v_count <= V_START - 10'd1;
					else if( hold_lines == ACQ_TIMEOUT ) begin
						v_count <= V_START;
						state <= ST_FREE;
					end
					else
						hold_lines <= hold_lines + 11'd1;
				end
				else if( state == ST_FREE )
					v_count <= (v_count == V_FREERUN - 10'd1) ? 10'd0 : v_count + 10'd1;
				else
					v_count <= (v_count == locked_total - 10'd1) ? 10'd0 : v_count + 10'd1;
			end

			if( acq_seen && !go_resync ) begin
				// Align the output line phase to the input once; it then stays fixed
				// because both line periods and frame lengths are identical.
				h_count <= H_LOCK;
				v_count <= V_START - 10'd1;
				locked_total <= frame_total;
				state <= ST_LOCK;
			end
		end
	end

	assign display_r = display_en ? ram_q[23:16] : 8'd0;
	assign display_g = display_en ? ram_q[15:8] : 8'd0;
	assign display_b = display_en ? ram_q[7:0] : 8'd0;
	assign locked = state == ST_LOCK;
endmodule
