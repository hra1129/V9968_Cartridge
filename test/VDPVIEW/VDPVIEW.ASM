; -----------------------------------------------------------------------------
;	VDPVIEW.ASM -- V9958 / V9968 visual check pages (MSX-DOS .COM)
;
;	Shows the pages generated by gen_vdpview.py (VDPVIEW.INC) one by one.
;	Compare every page with the reference images in VDPVIEW.md.
;		SPACE / RETURN / RIGHT : next page (quit after the last page)
;		BS / LEFT              : previous page
;		ESC                    : quit
;	Pages for the V9968 only are skipped on a V9958.
;	On a turboR the Z80 mode is used while the pages are shown.
;
;	Assemble with zma:  zma VDPVIEW.ASM VDPVIEW.COM
; -----------------------------------------------------------------------------

BDOS		:= 0x0005
_TERM0		:= 0x00
_PUTS		:= 0x09

RDSLT		:= 0x000C
CALSLT		:= 0x001C
CHGMOD		:= 0x005F		; main ROM
CHGCPU		:= 0x0180		; main ROM (turboR)
GETCPU		:= 0x0183		; main ROM (turboR)
INIPLT		:= 0x0141		; sub ROM
EXPTBL_M1	:= 0xFCC0		; [FCC1h] = main ROM slot
EXBRSA_M1	:= 0xFAF7		; [FAF8h] = sub ROM slot
SCRMOD		:= 0xFCAF
RG8SAV		:= 0xFFE7
RG9SAV		:= 0xFFE8

VDP_DATA	:= 0x98
VDP_CTRL	:= 0x99
VDP_PAL		:= 0x9A
VDP_IND		:= 0x9B
VDP_P4		:= 0x9C
PPI_B		:= 0xA9
PPI_C		:= 0xAA

ACT_NEXT	:= 1
ACT_PREV	:= 2
ACT_QUIT	:= 3

		org		0x100

		jp		entry_point
; fixed addresses for the automatic capture script (openMSX)
vv_page::	db		0			; 0103h: page index being shown
vv_ready::	db		0			; 0104h: 1 while waiting for a key
vv_sign::	db		"VDPV"		; 0105h

; -----------------------------------------------------------------------------
;	entry
; -----------------------------------------------------------------------------
entry_point::
		ld		de, msg_banner
		call	puts

		di
		call	detect_vdp
		ei
		ld		a, [vdp_id]
		or		a, a
		jr		nz, vdp_ok
		ld		de, msg_v9938
		call	puts
		jp		exit_dos
vdp_ok:
		call	turbo_r_z80
		call	wait_release

		xor		a, a
		ld		[cur], a
page_loop:
		call	run_page
		call	wait_release
		ld		a, [action]
		cp		a, ACT_QUIT
		jr		z, finish
		cp		a, ACT_PREV
		jr		z, page_prev
page_next:
		ld		a, [cur]
		inc		a
		ld		hl, page_count
		cp		a, [hl]
		jr		nc, finish
		ld		[cur], a
		call	page_skipped
		jr		nz, page_next
		jr		page_loop
page_prev:
		ld		a, [cur]
		or		a, a
		jr		z, page_loop
		dec		a
		ld		[cur], a
		call	page_skipped
		jr		nz, page_prev
		jr		page_loop

finish:
		call	restore_screen
		ei
		call	turbo_r_restore
		ld		de, msg_end
		call	puts
exit_dos:
		ld		c, _TERM0
		jp		BDOS

;	NZ = page [cur] is for the V9968 only and no V9968 is present
page_skipped:
		call	page_entry
		ld		a, [hl]
		and		a, 1
		ret		z
		ld		a, [is_v9968]
		xor		a, 1
		ret

;	HL = page_table + cur * 3
page_entry:
		ld		a, [cur]
		ld		l, a
		ld		h, 0
		ld		e, l
		ld		d, h
		add		hl, hl
		add		hl, de
		ld		de, page_table
		add		hl, de
		ret

; -----------------------------------------------------------------------------
;	turboR: Z80 mode while running
; -----------------------------------------------------------------------------
turbo_r_z80:
		xor		a, a
		ld		[is_turbo_r], a
		ld		a, [EXPTBL_M1 + 1]
		ld		hl, 0x002D
		call	RDSLT
		ei
		cp		a, 3
		ret		c
		ld		a, 1
		ld		[is_turbo_r], a
		ld		iy, [EXPTBL_M1]
		ld		ix, GETCPU
		call	CALSLT
		ld		[saved_cpu], a
		ld		a, 0x80
		ld		iy, [EXPTBL_M1]
		ld		ix, CHGCPU
		call	CALSLT
		ei
		ret

turbo_r_restore:
		ld		a, [is_turbo_r]
		or		a, a
		ret		z
		ld		a, [saved_cpu]
		or		a, 0x80
		ld		iy, [EXPTBL_M1]
		ld		ix, CHGCPU
		call	CALSLT
		ei
		ret

; -----------------------------------------------------------------------------
;	keyboard (PPI direct, works with DI)
;	A = 0 none / ACT_NEXT / ACT_PREV / ACT_QUIT
; -----------------------------------------------------------------------------
get_key:
		in		a, [PPI_C]
		and		a, 0xF0
		or		a, 7
		out		[PPI_C], a
		in		a, [PPI_B]
		ld		c, a
		in		a, [PPI_C]
		and		a, 0xF0
		or		a, 8
		out		[PPI_C], a
		in		a, [PPI_B]
		ld		b, a
		ld		a, ACT_QUIT
		bit		2, c			; ESC
		ret		z
		ld		a, ACT_NEXT
		bit		7, c			; RETURN
		ret		z
		bit		0, b			; SPACE
		ret		z
		bit		7, b			; RIGHT
		ret		z
		ld		a, ACT_PREV
		bit		5, c			; BS
		ret		z
		bit		4, b			; LEFT
		ret		z
		xor		a, a
		ret

wait_release:
		ld		de, 0x0800
wait_release_loop:
		call	get_key
		or		a, a
		jr		nz, wait_release
		dec		de
		ld		a, d
		or		a, e
		jr		nz, wait_release_loop
		ret

;	sets vv_ready while waiting, A = action
wait_action:
		ld		a, 1
		ld		[vv_ready], a
wait_action_loop:
		call	get_key
		or		a, a
		jr		z, wait_action_loop
		ld		[action], a
		xor		a, a
		ld		[vv_ready], a
		ret

; -----------------------------------------------------------------------------
;	VDP helpers
; -----------------------------------------------------------------------------
;	A = value, B = register
wreg:
		out		[VDP_CTRL], a
		ld		a, b
		or		a, 0x80
		out		[VDP_CTRL], a
		ret

;	A = status register number -> A = value, R#15 back to 0
rstat:
		ld		b, 15
		call	wreg
		in		a, [VDP_CTRL]
		push	af
		xor		a, a
		ld		b, 15
		call	wreg
		pop		af
		ret

wait_ce:
		ld		a, 2
		ld		b, 15
		call	wreg
wait_ce_loop:
		in		a, [VDP_CTRL]
		rrca
		jr		c, wait_ce_loop
		xor		a, a
		ld		b, 15
		jp		wreg

;	HL = 11 bytes for R#36-R#46
vdp_cmd36:
		ld		a, 36
		ld		b, 17
		call	wreg
		ld		bc, 0x0B00 | VDP_IND
		otir
		jr		wait_ce

; -----------------------------------------------------------------------------
;	one page
; -----------------------------------------------------------------------------
run_page:
		ld		a, [cur]
		ld		[vv_page], a
		xor		a, a
		ld		[action], a
		call	page_prepare
		call	page_entry
		inc		hl
		ld		a, [hl]
		inc		hl
		ld		h, [hl]
		ld		l, a
interp_loop:
		ld		a, [hl]
		inc		hl
		cp		a, OPCODE_COUNT
		jr		nc, interp_broken
		push	hl
		add		a, a
		ld		e, a
		ld		d, 0
		ld		hl, op_table
		add		hl, de
		ld		e, [hl]
		inc		hl
		ld		d, [hl]
		ld		[op_jump + 1], de
		pop		hl
		call	op_jump
		ld		a, [action]
		or		a, a
		jr		z, interp_loop
		ret
interp_broken:
		ld		a, ACT_QUIT
		ld		[action], a
		ret

op_jump:
		jp		0

op_table:
		dw		op_end			; 00
		dw		op_reg			; 01
		dw		op_p4			; 02
		dw		op_pal			; 03
		dw		op_vram			; 04
		dw		op_show			; 05
		dw		op_line			; 06
		dw		op_poll			; 07
		dw		op_cmd			; 08
OPCODE_COUNT	:= 9

;	display off, all VRAM cleared, extension registers back to default
page_prepare:
		di
		xor		a, a
		ld		b, 1
		call	wreg			; display off, no interrupts
		xor		a, a
		ld		b, 46
		call	wreg
		ld		a, [is_v9968]
		or		a, a
		jr		z, page_prepare_1
		xor		a, a
		out		[VDP_P4], a
		xor		a, a
		ld		b, 20
		call	wreg
		ld		a, 1
		ld		b, 21
		call	wreg
		ld		a, 0x80
		out		[VDP_P4], a
page_prepare_1:
		ld		hl, prepare_regs
page_prepare_reg:
		ld		b, [hl]
		inc		hl
		ld		a, b
		cp		a, 0xFF
		jr		z, page_prepare_clear
		ld		a, [hl]
		inc		hl
		call	wreg
		jr		page_prepare_reg
page_prepare_clear:
		ld		hl, cmd_clear0
		call	vdp_cmd36
		ld		hl, cmd_clear1
		jp		vdp_cmd36

prepare_regs:
		db		0, 0x06			; GRAPHIC 4 for the clear
		db		8, 0x08
		db		9, 0x00
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		db		0xFF

cmd_clear0:
		db		0, 0, 0, 0, 0, 1, 0, 2, 0, 0, 0xC0		; HMMV (0,0)-(255,511)
cmd_clear1:
		db		0, 0, 0, 2, 0, 1, 0, 2, 0, 0, 0xC0		; HMMV (0,512)-(255,1023)

; --- op codes (HL = script pointer) -------------------------------------------
op_end:
		ld		a, ACT_QUIT
		ld		[action], a
		ret

op_reg:
		ld		b, [hl]
		inc		hl
		ld		a, [hl]
		inc		hl
		jp		wreg

op_p4:
		ld		a, [hl]
		inc		hl
		out		[VDP_P4], a
		ret

op_pal:
		ld		e, [hl]
		inc		hl
		ld		d, [hl]
		inc		hl
		push	hl
		xor		a, a
		ld		b, 16
		call	wreg
		pop		hl
op_pal_loop:
		ld		a, d
		or		a, e
		ret		z
		ld		a, [hl]
		inc		hl
		out		[VDP_PAL], a
		dec		de
		jr		op_pal_loop

op_vram:
		ld		e, [hl]
		inc		hl
		ld		d, [hl]
		inc		hl
		ld		a, [hl]
		inc		hl
		add		a, a
		add		a, a
		ld		b, a
		ld		a, d
		rlca
		rlca
		and		a, 0x03
		or		a, b
		out		[VDP_CTRL], a
		ld		a, 0x8E
		out		[VDP_CTRL], a
		ld		a, e
		out		[VDP_CTRL], a
		ld		a, d
		and		a, 0x3F
		or		a, 0x40
		out		[VDP_CTRL], a
op_vram_loop:
		ld		a, [hl]
		inc		hl
		or		a, a
		ret		z
		cp		a, 0x80
		jr		c, op_vram_literal
		cp		a, 0xFF
		jr		z, op_vram_long
		sub		a, 0x7D
		ld		c, a
		ld		b, 0
		jr		op_vram_fill
op_vram_long:
		ld		c, [hl]
		inc		hl
		ld		b, [hl]
		inc		hl
op_vram_fill:
		ld		a, [hl]
		inc		hl
op_vram_fill_loop:
		out		[VDP_DATA], a
		dec		bc
		ld		d, a
		ld		a, b
		or		a, c
		ld		a, d
		jr		nz, op_vram_fill_loop
		jr		op_vram_loop
op_vram_literal:
		ld		b, a
		ld		c, VDP_DATA
		otir
		jr		op_vram_loop

op_cmd:
		ld		a, 32
		ld		b, 17
		call	wreg
		ld		bc, 0x0F00 | VDP_IND
		otir
		push	hl
		call	wait_ce
		pop		hl
		ret

op_show:
		di
		jp		wait_action

;	r0, start_r19, entries {n, n bytes (value, reg|80h), next_r19, wrap}
op_line:
		ld		a, [hl]
		inc		hl
		ld		[line_r0], a
		ld		a, [hl]
		inc		hl
		ld		[lstart], hl
		ld		[lptr], hl
		ld		b, 19
		call	wreg
		ld		hl, [0x0038]
		ld		[saved_38], hl
		ld		a, [0x003A]
		ld		[saved_38 + 2], a
		ld		a, 0xC3
		ld		[0x0038], a
		ld		hl, line_isr
		ld		[0x0039], hl
		ld		a, 1
		ld		b, 15
		call	wreg			; S#1 stays selected while the page is shown
		in		a, [VDP_CTRL]
		ld		a, [line_r0]
		ld		b, 0
		call	wreg			; IE1 = 1
		ei
		call	wait_action
		di
		ld		a, [line_r0]
		and		a, 0xEF
		ld		b, 0
		call	wreg
		in		a, [VDP_CTRL]
		xor		a, a
		ld		b, 15
		call	wreg
		ld		hl, [saved_38]
		ld		[0x0038], hl
		ld		a, [saved_38 + 2]
		ld		[0x003A], a
		ret

line_isr:
		push	af
		push	bc
		push	hl
		in		a, [VDP_CTRL]	; S#1, clears FH
		rrca
		jr		nc, line_isr_end
		ld		hl, [lptr]
		ld		b, [hl]
		inc		hl
		ld		c, VDP_CTRL
		ld		a, b
		or		a, a
		jr		z, line_isr_r19
		otir
line_isr_r19:
		ld		a, [hl]
		inc		hl
		out		[VDP_CTRL], a
		ld		a, 0x80 | 19
		out		[VDP_CTRL], a
		ld		a, [hl]
		inc		hl
		or		a, a
		jr		z, line_isr_store
		ld		hl, [lstart]
line_isr_store:
		ld		[lptr], hl
line_isr_end:
		pop		hl
		pop		bc
		pop		af
		ei
		ret

;	{n, pairs} at VR rise, {n, pairs} at VR fall, count, {hr, n, pairs} ...
op_poll:
		ld		[poll_rise], hl
		call	skip_pairs
		ld		[poll_fall], hl
		call	skip_pairs
		ld		a, [hl]
		inc		hl
		ld		[poll_count], a
		ld		[poll_ent], hl
		ld		a, 2
		ld		b, 15
		call	wreg
		ld		a, 1
		ld		[vv_ready], a
poll_frame:
		in		a, [VDP_CTRL]
		and		a, 0x40
		jr		z, poll_frame
		ld		hl, [poll_rise]
		call	out_pairs
poll_vr_fall:
		in		a, [VDP_CTRL]
		and		a, 0x40
		jr		nz, poll_vr_fall
		ld		hl, [poll_fall]
		call	out_pairs
		ld		hl, [poll_ent]
		ld		a, [poll_count]
		ld		d, a
poll_entry:
		ld		a, d
		or		a, a
		jr		z, poll_key
		ld		e, [hl]
		inc		hl
poll_hr_low:
		in		a, [VDP_CTRL]
		and		a, 0x20
		jr		nz, poll_hr_low
poll_hr_high:
		in		a, [VDP_CTRL]
		and		a, 0x20
		jr		z, poll_hr_high
		dec		e
		jr		nz, poll_hr_low
		call	out_pairs
		dec		d
		jr		poll_entry
poll_key:
		call	get_key
		or		a, a
		jr		z, poll_frame
		ld		[action], a
		xor		a, a
		ld		[vv_ready], a
		xor		a, a
		ld		b, 15
		jp		wreg

skip_pairs:
		ld		e, [hl]
		inc		hl
		ld		d, 0
		add		hl, de
		ret

out_pairs:
		ld		b, [hl]
		inc		hl
		ld		a, b
		or		a, a
		ret		z
		ld		c, VDP_CTRL
		otir
		ret

; -----------------------------------------------------------------------------
;	VDP detection (DI)
; -----------------------------------------------------------------------------
detect_vdp:
		ld		a, 1
		call	rstat
		rrca
		and		a, 0x1F
		ld		[vdp_id], a
		xor		a, a
		ld		[is_v9968], a
		ld		a, [vdp_id]
		or		a, a
		ret		z
		in		a, [VDP_P4]
		and		a, 0x78
		ret		nz
		xor		a, a
		out		[VDP_P4], a
		in		a, [VDP_P4]
		and		a, 0x80
		jr		nz, detect_relock
		xor		a, a
		ld		b, 21
		call	wreg
		ld		a, 1
		call	rstat
		rrca
		and		a, 0x1F
		cp		a, 3
		jr		nz, detect_restore
		ld		a, 1
		ld		[is_v9968], a
detect_restore:
		xor		a, a
		ld		b, 20
		call	wreg
		ld		a, 1
		ld		b, 21
		call	wreg
detect_relock:
		ld		a, 0x80
		out		[VDP_P4], a
		ret

; -----------------------------------------------------------------------------
;	back to the DOS text screen
; -----------------------------------------------------------------------------
restore_screen:
		di
		xor		a, a
		ld		b, 1
		call	wreg
		xor		a, a
		ld		b, 46
		call	wreg
		ld		a, [is_v9968]
		or		a, a
		jr		z, restore_common
		xor		a, a
		out		[VDP_P4], a
		xor		a, a
		ld		b, 20
		call	wreg
		ld		a, 1
		ld		b, 21
		call	wreg
		ld		a, 0x80
		out		[VDP_P4], a
restore_common:
		ld		hl, restore_regs
restore_reg:
		ld		b, [hl]
		inc		hl
		ld		a, b
		cp		a, 0xFF
		jr		z, restore_bios
		ld		a, [hl]
		inc		hl
		call	wreg
		jr		restore_reg
restore_bios:
		ld		a, [RG8SAV]
		ld		b, 8
		call	wreg
		ld		a, [RG9SAV]
		ld		b, 9
		call	wreg
		ld		a, [SCRMOD]
		ld		iy, [EXPTBL_M1]
		ld		ix, CHGMOD
		call	CALSLT
		di
		ld		iy, [EXBRSA_M1]
		ld		ix, INIPLT
		call	CALSLT
		ret

restore_regs:
		db		0, 0
		db		15, 0
		db		19, 0
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		db		0xFF

puts:
		ld		c, _PUTS
		jp		BDOS

; -----------------------------------------------------------------------------
;	messages
; -----------------------------------------------------------------------------
msg_banner:
		db		"VDPVIEW - VDP visual check", 0x0D, 0x0A
		db		"SPACE/RET/RIGHT:next  BS/LEFT:back  ESC:quit", 0x0D, 0x0A, "$"
msg_v9938:
		db		"V9938 detected. V9958 or V9968 is required.", 0x0D, 0x0A, "$"
msg_end:
		db		"VDPVIEW END", 0x0D, 0x0A, "$"

; -----------------------------------------------------------------------------
;	work area
; -----------------------------------------------------------------------------
cur::		db		0
action::	db		0
vdp_id::	db		0
is_v9968::	db		0
is_turbo_r::	db		0
saved_cpu::	db		0
line_r0::	db		0
lstart::	dw		0
lptr::		dw		0
saved_38::	db		0, 0, 0
poll_rise::	dw		0
poll_fall::	dw		0
poll_ent::	dw		0
poll_count::	db		0

		include	"VDPVIEW.INC"
program_end::
