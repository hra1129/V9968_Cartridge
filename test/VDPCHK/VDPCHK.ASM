; -----------------------------------------------------------------------------
;	VDPCHK.ASM -- V9958 / V9968 VDP command and VRAM self check (MSX-DOS .COM)
;
;	Executes the test script generated by gen_vdpchk.py (VDPCHK.INC).
;	Every test fills the area it touches with a known pattern, runs CPU
;	VRAM accesses or a VDP command, reads the area back by the CPU and
;	compares the CRC-16 of everything read with the expected value that
;	was computed by the reference model (openMSX compatible).
;
;	At the end the screen is returned to the DOS text mode and
;		RESULT: <failed>/<total>
;	is printed, followed by "SUCCESS OF ALL" or the numbers of the failed
;	tests (see test_item.md).  A trailing 'T' means a timeout.
;	Sections for V9968 only are skipped when no V9968 is detected.
;
;	Assemble with zma:  zma VDPCHK.ASM VDPCHK.COM
;	Target: MSX2+ (V9958) or V9968, 128 KB VRAM, MSX-DOS 1 or 2.
; -----------------------------------------------------------------------------

BDOS		:= 0x0005
TPA_TOP		:= 0x0006
_TERM0		:= 0x00
_CONOUT		:= 0x02
_PUTS		:= 0x09

CALSLT		:= 0x001C
CHGMOD		:= 0x005F		; main ROM
INIPLT		:= 0x0141		; sub ROM
EXPTBL_M1	:= 0xFCC0		; [FCC1h] = main ROM slot
EXBRSA_M1	:= 0xFAF7		; [FAF8h] = sub ROM slot
SCRMOD		:= 0xFCAF
RG8SAV		:= 0xFFE7
RG9SAV		:= 0xFFE8

VDP_DATA	:= 0x98
VDP_CTRL	:= 0x99
VDP_PAL		:= 0x9A
VDP_IND		:= 0x9B
VDP_P4		:= 0x9C

TIMEOUT_OUTER	:= 32			; timeout: 32 x 65536 polls (about 25 s at 3.58 MHz)
MAX_FAILS	:= 200			; numbers kept for the report

		org		0x100

; -----------------------------------------------------------------------------
;	entry
; -----------------------------------------------------------------------------
entry_point::
		ld		de, msg_banner
		call	puts

		; page aligned table area just after the program: PAT, CRC hi, CRC lo
		ld		hl, program_end + 255
		ld		l, 0
		ld		a, h
		ld		[tblpage], a
		add		a, 4			; 3 tables + 1 page margin for the stack
		ld		b, a
		ld		a, [TPA_TOP + 1]
		cp		a, b
		jp		c, err_tpa
		ex		de, hl
		ld		hl, pat_table
		ld		bc, 768			; pat_table, crc_table_hi, crc_table_lo are contiguous
		ldir

		di
		call	detect_vdp
		ld		a, [vdp_id]
		or		a, a
		jr		nz, vdp_ok
		ei
		ld		de, msg_v9938
		call	puts
		jp		exit_dos
vdp_ok:
		ei
		ld		a, [is_v9968]
		or		a, a
		ld		de, msg_v9958
		jr		z, print_kind
		ld		de, msg_v9968
print_kind:
		call	puts
		ld		de, msg_running
		call	puts

		di
		ld		hl, script
		ld		[spc], hl
		ld		hl, fail_list
		ld		[fail_ptr], hl
main_loop:
		call	fetch_b
		cp		a, OPCODE_COUNT
		jr		nc, script_broken
		add		a, a
		ld		l, a
		ld		h, 0
		ld		de, op_table
		add		hl, de
		ld		a, [hl]
		inc		hl
		ld		h, [hl]
		ld		l, a
		call	jp_hl
		ld		a, [done]
		or		a, a
		jr		z, main_loop
		jr		finish
script_broken:
		ld		a, 1
		ld		[broken], a

finish:
		call	restore_screen
		ei
		call	print_result
exit_dos:
		ld		c, _TERM0
		jp		BDOS

err_tpa:
		ld		de, msg_tpa
		call	puts
		jr		exit_dos

jp_hl:
		jp		hl

; -----------------------------------------------------------------------------
;	op code table
; -----------------------------------------------------------------------------
op_table:
		dw		op_end			; 00
		dw		op_test			; 01
		dw		op_check		; 02
		dw		op_reg			; 03
		dw		op_p4			; 04
		dw		op_cmd			; 05
		dw		op_waitce		; 06
		dw		op_feed			; 07
		dw		op_drain		; 08
		dw		op_stat			; 09
		dw		op_fillp		; 0A
		dw		op_fillc		; 0B
		dw		op_read			; 0C
		dw		op_cpuw			; 0D
		dw		op_cpur			; 0E
		dw		op_section		; 0F
OPCODE_COUNT	:= 16

; -----------------------------------------------------------------------------
;	script fetch
; -----------------------------------------------------------------------------
fetch_b:
		ld		hl, [spc]
		ld		a, [hl]
		inc		hl
		ld		[spc], hl
		ret

fetch_w:					; HL = word
		ld		hl, [spc]
		ld		e, [hl]
		inc		hl
		ld		d, [hl]
		inc		hl
		ld		[spc], hl
		ex		de, hl
		ret

fetch_a24:					; va_lo/va_mid/va_hi
		call	fetch_b
		ld		[va_lo], a
		call	fetch_b
		ld		[va_mid], a
		call	fetch_b
		and		a, 0x03
		ld		[va_hi], a
		ret

fetch_len:					; rem = len16 (0 means 65536)
		call	fetch_w
		ld		[rem_l], hl
		ld		a, h
		or		a, l
		ld		a, 0
		jr		nz, fetch_len_1
		inc		a
fetch_len_1:
		ld		[rem_h], a
		ret

; -----------------------------------------------------------------------------
;	VDP helpers
; -----------------------------------------------------------------------------
;	A = value, B = register
wreg:
		out		[VDP_CTRL], a
		ld		a, b
		or		a, 0x80
		out		[VDP_CTRL], a
		ret

;	A = status register number -> A = value, R#15 back to 0
rstat:
		ld		b, 15
		call	wreg
		in		a, [VDP_CTRL]
		push	af
		xor		a, a
		ld		b, 15
		call	wreg
		pop		af
		ret

;	VRAM address from va_lo/va_mid/va_hi.  A = 0x00 read / 0x40 write
set_addr:
		ld		c, a
		ld		a, [va_hi]
		add		a, a
		add		a, a
		ld		b, a
		ld		a, [va_mid]
		rlca
		rlca
		and		a, 0x03
		or		a, b
		out		[VDP_CTRL], a
		ld		a, 0x8E
		out		[VDP_CTRL], a
		ld		a, [va_lo]
		out		[VDP_CTRL], a
		ld		a, [va_mid]
		and		a, 0x3F
		or		a, c
		out		[VDP_CTRL], a
		ret

;	A = byte -> crc
crc_add:
		push	hl
		push	de
		ld		de, [crc]
		xor		a, d
		ld		l, a
		ld		a, [tblpage]
		inc		a
		ld		h, a
		ld		a, [hl]
		xor		a, e
		ld		d, a
		inc		h
		ld		e, [hl]
		ld		[crc], de
		pop		de
		pop		hl
		ret

;	timeout counter
to_init:
		ld		a, TIMEOUT_OUTER
		ld		[to_outer], a
		ld		hl, 0
		ld		[to_inner], hl
		ret

;	Z = timed out
to_tick:
		ld		hl, [to_inner]
		dec		hl
		ld		[to_inner], hl
		ld		a, h
		or		a, l
		jr		nz, to_tick_alive
		ld		a, [to_outer]
		dec		a
		ld		[to_outer], a
		ret
to_tick_alive:
		or		a, 1			; NZ
		ret

timeout_stop:
		ld		a, 1
		ld		[cur_to], a
		xor		a, a
		ld		b, 46
		call	wreg			; STOP
		xor		a, a
		ld		b, 15
		jp		wreg

; -----------------------------------------------------------------------------
;	op codes
; -----------------------------------------------------------------------------
op_end:
		ld		a, 1
		ld		[done], a
		ret

op_test:
		call	fetch_w
		ld		[cur_test], hl
		xor		a, a
		ld		[cur_to], a
		ld		hl, 0xFFFF
		ld		[crc], hl
		ret

op_check:
		call	fetch_w
		ld		de, [total]
		inc		de
		ld		[total], de
		ld		de, [crc]
		or		a, a
		sbc		hl, de
		ld		a, [cur_to]
		jr		nz, check_ng
		or		a, a
		ret		z
check_ng:
		ld		de, [ng]
		inc		de
		ld		[ng], de
		ld		de, [fail_cnt]
		ld		hl, MAX_FAILS
		or		a, a
		sbc		hl, de
		ret		z				; list full (ng is still counted)
		inc		de
		ld		[fail_cnt], de
		ld		hl, [fail_ptr]
		ld		de, [cur_test]
		or		a, a			; A = cur_to
		jr		z, check_store
		set		7, d			; bit15 = timeout
check_store:
		ld		[hl], e
		inc		hl
		ld		[hl], d
		inc		hl
		ld		[fail_ptr], hl
		ret

op_reg:
		call	fetch_b
		ld		b, a
		call	fetch_b
		out		[VDP_CTRL], a
		ld		a, b
		or		a, 0x80
		out		[VDP_CTRL], a
		ret

op_p4:
		call	fetch_b
		out		[VDP_P4], a
		ret

op_cmd:
		ld		a, 32
		ld		b, 17
		call	wreg
		ld		hl, [spc]
		ld		bc, 0x0F00 | VDP_IND	; 15 bytes R#32-R#46
		otir
		ld		[spc], hl
		ret

op_waitce:
		call	to_init
		ld		a, 2
		ld		b, 15
		call	wreg
waitce_loop:
		in		a, [VDP_CTRL]
		rrca
		jr		nc, waitce_done
		call	to_tick
		jr		nz, waitce_loop
		jp		timeout_stop
waitce_done:
		xor		a, a
		ld		b, 15
		jp		wreg

op_feed:
		call	fetch_b
		inc		a
		ld		[feed_idx], a
		ld		a, 44 | 0x80	; R#17: R#44, no auto increment
		ld		b, 17
		call	wreg
		call	to_init
		ld		a, 2
		ld		b, 15
		call	wreg
feed_loop:
		in		a, [VDP_CTRL]
		rrca
		jr		nc, waitce_done
		rlca
		rlca
		jr		nc, feed_wait
		ld		a, [tblpage]
		ld		h, a
		ld		a, [feed_idx]
		ld		l, a
		inc		a
		ld		[feed_idx], a
		ld		a, [hl]
		out		[VDP_IND], a
		jr		feed_loop
feed_wait:
		call	to_tick
		jr		nz, feed_loop
		jp		timeout_stop

op_drain:
		ld		hl, 0
		ld		[drain_cnt], hl
		call	to_init
		ld		a, 2
		ld		b, 15
		call	wreg
drain_loop:
		in		a, [VDP_CTRL]
		ld		c, a
		rlca
		jr		nc, drain_no_tr
		ld		a, 7
		ld		b, 15
		call	wreg
		in		a, [VDP_CTRL]
		call	crc_add
		ld		hl, [drain_cnt]
		inc		hl
		ld		[drain_cnt], hl
		ld		a, 2
		ld		b, 15
		call	wreg
drain_no_tr:
		ld		a, c
		rrca
		jr		nc, drain_done
		call	to_tick
		jr		nz, drain_loop
		call	timeout_stop
drain_done:
		xor		a, a
		ld		b, 15
		call	wreg
		ld		a, [drain_cnt]
		call	crc_add
		ld		a, [drain_cnt + 1]
		jp		crc_add

op_stat:
		call	fetch_b
		ld		c, a
		call	fetch_b
		ld		d, a
		ld		a, c
		call	rstat
		ld		e, a
		ld		a, d
		or		a, a
		ret		z
		and		a, e
		jp		crc_add

op_section:
		call	fetch_b
		ld		c, a
		call	fetch_w
		push	hl				; number of tests
		call	fetch_w			; HL = length
		pop		de
		bit		0, c
		ret		z
		ld		a, [is_v9968]
		or		a, a
		ret		nz
		ex		de, hl
		ld		bc, [skipped]
		add		hl, bc
		ld		[skipped], hl
		ld		hl, [spc]
		add		hl, de
		ld		[spc], hl
		ret

; --- block operations split at 16 KB boundaries -----------------------------
op_fillp:
		call	fetch_a24
		call	fetch_len
		call	fetch_b
		ld		[seed], a
		ld		hl, fillp_chunk
		ld		a, 0x40
		jr		chunk_run

op_fillc:
		call	fetch_a24
		call	fetch_len
		call	fetch_b
		ld		[seed], a
		ld		hl, fillc_chunk
		ld		a, 0x40
		jr		chunk_run

op_read:
		call	fetch_a24
		call	fetch_len
		ld		hl, read_chunk
		xor		a, a

;	HL = chunk routine (BC = bytes), A = 0x00 read / 0x40 write
chunk_run:
		ld		[chunk_fn], hl
		ld		[chunk_rw], a
chunk_loop:
		ld		hl, [rem_l]
		ld		a, h
		or		a, l
		ld		b, a
		ld		a, [rem_h]
		or		a, b
		ret		z
		; csz = 4000h - (addr & 3FFFh)
		ld		a, [va_mid]
		and		a, 0x3F
		ld		d, a
		ld		a, [va_lo]
		ld		e, a
		ld		hl, 0x4000
		or		a, a
		sbc		hl, de
		; csz = min(csz, rem)
		ld		a, [rem_h]
		or		a, a
		jr		nz, chunk_size_ok
		ld		de, [rem_l]
		push	hl
		or		a, a
		sbc		hl, de
		pop		hl
		jr		c, chunk_size_ok
		ex		de, hl
chunk_size_ok:
		ld		[csz], hl
		ex		de, hl
		ld		hl, [rem_l]
		or		a, a
		sbc		hl, de
		ld		[rem_l], hl
		ld		a, [rem_h]
		sbc		a, 0
		ld		[rem_h], a
		ld		a, [chunk_rw]
		call	set_addr
		ld		bc, [csz]
		ld		hl, [chunk_fn]
		call	jp_hl
		ld		hl, [va_lo]		; L = va_lo, H = va_mid
		ld		de, [csz]
		add		hl, de
		ld		[va_lo], hl
		ld		a, [va_hi]
		adc		a, 0
		and		a, 0x03
		ld		[va_hi], a
		jr		chunk_loop

;	pattern: PAT[(lo + off) & FFh], off = mid * 4Dh + hi * 9Bh + seed
fillp_chunk:
		push	bc
		ld		a, [va_mid]
		ld		b, a
		ld		a, [seed]
		inc		b
		jr		fillp_mul_next
fillp_mul:
		add		a, 0x4D
fillp_mul_next:
		djnz	fillp_mul
		ld		d, a
		ld		a, [va_hi]
		and		a, 0x01
		ld		a, d
		jr		z, fillp_no_hi
		add		a, 0x9B
fillp_no_hi:
		ld		d, a			; D = off
		ld		a, [va_lo]
		ld		e, a			; E = lo
		ld		a, [tblpage]
		ld		h, a
		pop		bc
fillp_loop:
		ld		a, e
		add		a, d
		ld		l, a
		ld		a, [hl]
		out		[VDP_DATA], a
		inc		e
		jr		nz, fillp_same_page
		ld		a, d
		add		a, 0x4D
		ld		d, a
fillp_same_page:
		dec		bc
		ld		a, b
		or		a, c
		jr		nz, fillp_loop
		ret

fillc_chunk:
		ld		a, [seed]
		ld		e, a
fillc_loop:
		ld		a, e
		out		[VDP_DATA], a
		dec		bc
		ld		a, b
		or		a, c
		jr		nz, fillc_loop
		ret

read_chunk:
		ld		de, [crc]
		ld		a, [tblpage]
		inc		a
		ld		h, a
read_loop:
		in		a, [VDP_DATA]
		xor		a, d
		ld		l, a
		ld		a, [hl]
		xor		a, e
		ld		d, a
		inc		h
		ld		e, [hl]
		dec		h
		dec		bc
		ld		a, b
		or		a, c
		jr		nz, read_loop
		ld		[crc], de
		ret

; --- CPU sequential access (address is set only once) -----------------------
op_cpuw:
		call	fetch_a24
		call	fetch_w
		push	hl
		call	fetch_b
		push	af
		ld		a, 0x40
		call	set_addr
		pop		af
		ld		l, a
		ld		a, [tblpage]
		ld		h, a
		pop		bc
cpuw_loop:
		ld		a, [hl]
		out		[VDP_DATA], a
		inc		l
		dec		bc
		ld		a, b
		or		a, c
		jr		nz, cpuw_loop
		ret

op_cpur:
		call	fetch_a24
		call	fetch_w
		push	hl
		xor		a, a
		call	set_addr
		pop		bc
		jr		read_chunk

; -----------------------------------------------------------------------------
;	VDP detection (DI)
;	vdp_id   : S#1 ID (0 = V9938)
;	is_v9968 : 1 when the V9968 extension is present
; -----------------------------------------------------------------------------
detect_vdp:
		ld		a, 1
		call	rstat
		rrca
		and		a, 0x1F
		ld		[vdp_id], a
		xor		a, a
		ld		[is_v9968], a
		ld		a, [vdp_id]
		or		a, a
		ret		z
		; Port#4 of the V9968 reads {lock, 0000, CI, LI, FI}; nothing there reads FFh
		in		a, [VDP_P4]
		and		a, 0x78
		ret		nz
		xor		a, a
		out		[VDP_P4], a		; unlock R#20/R#21
		in		a, [VDP_P4]
		and		a, 0x80
		jr		nz, detect_relock
		xor		a, a
		ld		b, 21
		call	wreg			; V58 = 0
		ld		a, 1
		call	rstat
		rrca
		and		a, 0x1F
		cp		a, 3
		jr		nz, detect_restore
		ld		a, 1
		ld		[is_v9968], a
detect_restore:
		xor		a, a
		ld		b, 20
		call	wreg
		ld		a, 1
		ld		b, 21
		call	wreg			; V58 = 1
detect_relock:
		ld		a, 0x80
		out		[VDP_P4], a
		ret

; -----------------------------------------------------------------------------
;	back to the DOS text screen
; -----------------------------------------------------------------------------
restore_screen:
		di
		xor		a, a
		ld		b, 46
		call	wreg			; stop a command that may be running
		ld		a, [is_v9968]
		or		a, a
		jr		z, restore_common
		xor		a, a
		out		[VDP_P4], a
		xor		a, a
		ld		b, 20
		call	wreg
		ld		a, 1
		ld		b, 21
		call	wreg
		ld		a, 0x80
		out		[VDP_P4], a
restore_common:
		xor		a, a
		ld		b, 25
		call	wreg
		xor		a, a
		ld		b, 26
		call	wreg
		xor		a, a
		ld		b, 27
		call	wreg
		xor		a, a
		ld		b, 23
		call	wreg
		xor		a, a
		ld		b, 45
		call	wreg
		ld		a, [RG8SAV]
		ld		b, 8
		call	wreg
		ld		a, [RG9SAV]
		ld		b, 9
		call	wreg
		xor		a, a
		ld		b, 15
		call	wreg
		; CHGMOD rebuilds the text screen (tables, font, registers)
		ld		a, [SCRMOD]
		ld		iy, [EXPTBL_M1]
		ld		ix, CHGMOD
		call	CALSLT
		di
		; the palette table in VRAM was overwritten by the tests
		ld		iy, [EXBRSA_M1]
		ld		ix, INIPLT
		call	CALSLT
		ret

; -----------------------------------------------------------------------------
;	report
; -----------------------------------------------------------------------------
print_result:
		ld		a, [broken]
		or		a, a
		jr		z, print_result_1
		ld		de, msg_broken
		call	puts
print_result_1:
		ld		de, msg_result
		call	puts
		ld		hl, [ng]
		call	put_dec
		ld		e, '/'
		call	putc
		ld		hl, [total]
		call	put_dec
		call	put_crlf

		ld		hl, [ng]
		ld		a, h
		or		a, l
		jr		nz, print_fails
		ld		de, msg_success
		call	puts
		jr		print_skipped
print_fails:
		ld		de, msg_failed
		call	puts
		ld		hl, fail_list
		ld		bc, [fail_cnt]
		ld		a, 0
		ld		[col], a
print_fail_loop:
		ld		a, b
		or		a, c
		jr		z, print_fail_end
		push	bc
		ld		e, [hl]
		inc		hl
		ld		d, [hl]
		inc		hl
		push	hl
		push	de
		res		7, d
		ex		de, hl
		call	put_dec
		pop		de
		bit		7, d
		jr		z, print_fail_sep
		ld		e, 'T'
		call	putc
print_fail_sep:
		ld		a, [col]
		inc		a
		ld		[col], a
		cp		a, 8
		jr		c, print_fail_space
		xor		a, a
		ld		[col], a
		call	put_crlf
		jr		print_fail_next
print_fail_space:
		ld		e, ' '
		call	putc
print_fail_next:
		pop		hl
		pop		bc
		dec		bc
		jr		print_fail_loop
print_fail_end:
		call	put_crlf
		ld		hl, [ng]
		ld		de, [fail_cnt]
		or		a, a
		sbc		hl, de
		jr		z, print_skipped
		ld		de, msg_more
		call	puts

print_skipped:
		ld		hl, [skipped]
		ld		a, h
		or		a, l
		ret		z
		ld		de, msg_skipped
		call	puts
		ld		hl, [skipped]
		call	put_dec
		ld		de, msg_skipped2
		jp		puts

puts:
		ld		c, _PUTS
		jp		BDOS

putc:
		push	hl
		push	bc
		ld		c, _CONOUT
		call	BDOS
		pop		bc
		pop		hl
		ret

put_crlf:
		ld		de, msg_crlf
		jp		puts

;	HL = value (decimal, no leading zeros)
put_dec:
		ld		b, 0			; digits printed
		ld		de, 10000
		call	put_dec_digit
		ld		de, 1000
		call	put_dec_digit
		ld		de, 100
		call	put_dec_digit
		ld		de, 10
		call	put_dec_digit
		ld		b, 1
		ld		de, 1
put_dec_digit:
		ld		a, '0' - 1
put_dec_sub:
		inc		a
		or		a, a
		sbc		hl, de
		jr		nc, put_dec_sub
		add		hl, de
		cp		a, '0'
		jr		nz, put_dec_out
		inc		b
		dec		b
		ret		z
put_dec_out:
		ld		b, 1
		push	de
		ld		e, a
		call	putc
		pop		de
		ret

; -----------------------------------------------------------------------------
;	messages
; -----------------------------------------------------------------------------
msg_banner:
		db		"VDPCHK - VDP command / VRAM self check", 0x0D, 0x0A, "$"
msg_v9938:
		db		"V9938 detected. V9958 or V9968 is required.", 0x0D, 0x0A, "$"
msg_v9958:
		db		"VDP: V9958 (V9968 only tests are skipped)", 0x0D, 0x0A, "$"
msg_v9968:
		db		"VDP: V9968", 0x0D, 0x0A, "$"
msg_running:
		db		"Running. This takes a few minutes...", 0x0D, 0x0A, "$"
msg_tpa:
		db		"Not enough memory.", 0x0D, 0x0A, "$"
msg_broken:
		db		"SCRIPT ERROR: unknown op code", 0x0D, 0x0A, "$"
msg_result:
		db		"RESULT: $"
msg_success:
		db		"SUCCESS OF ALL", 0x0D, 0x0A, "$"
msg_failed:
		db		"FAILED TESTS (T = timeout):", 0x0D, 0x0A, "$"
msg_more:
		db		"(more failures are not listed)", 0x0D, 0x0A, "$"
msg_skipped:
		db		"SKIPPED: $"
msg_skipped2:
		db		" (V9968 only)"
msg_crlf:
		db		0x0D, 0x0A, "$"

; -----------------------------------------------------------------------------
;	work area
; -----------------------------------------------------------------------------
spc::		dw		0
done::		db		0
broken::	db		0
tblpage::	db		0
vdp_id::	db		0
is_v9968::	db		0
cur_test::	dw		0
cur_to::	db		0
crc::		dw		0
total::		dw		0
ng::		dw		0
skipped::	dw		0
fail_cnt::	dw		0
fail_ptr::	dw		0
col::		db		0
va_lo::		db		0
va_mid::	db		0
va_hi::		db		0
rem_l::		dw		0
rem_h::		db		0
csz::		dw		0
chunk_fn::	dw		0
chunk_rw::	db		0
seed::		db		0
feed_idx::	db		0
drain_cnt::	dw		0
to_outer::	db		0
to_inner::	dw		0
fail_list::	space	MAX_FAILS * 2

		include	"VDPCHK.INC"
program_end::
